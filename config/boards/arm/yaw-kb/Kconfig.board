## config/boards/arm/yaw-kb/Kconfig.board
```kconfig
#
# Copyright (c) 2022 The ZMK Contributors
# SPDX-License-Identifier: MIT
#

config BOARD_YAW_KB
	bool "yaw-kb"
	depends on SOC_NRF52840_QIAA
```

## config/boards/arm/yaw-kb/Kconfig.defconfig
```kconfig
# Copyright (c) 2020 Stefan Sundin (4pplet)
# SPDX-License-Identifier: MIT

if BOARD_YAW_KB

config ZMK_KEYBOARD_NAME
	default "yaw-kb"

if USB

config USB_NRFX
	default y

config USB_DEVICE_STACK
	default y

endif # USB

config BOARD
    default "yaw-kb"

config BT_CTLR
	default BT

config ZMK_BLE
	default y

config ZMK_USB
	default y

config ZMK_BATTERY_VOLTAGE_DIVIDER

config ZMK_POINTING
    default y

config I2C
    default y

config ZMK_STUDIO
    default y

endif
```

## config/boards/arm/yaw-kb/yaw-kb_defconfig
```kconfig
#
# Copyright (c) 2022 The ZMK Contributors
# SPDX-License-Identifier: MIT
#

CONFIG_SOC_SERIES_NRF52X=y
CONFIG_SOC_NRF52840_QIAA=y
CONFIG_BOARD_YAW_KB=y
CONFIG_ZMK_SLEEP=y

CONFIG_EC11=y
CONFIG_EC11_TRIGGER_GLOBAL_THREAD=y 

CONFIG_ZMK_POINTING=y

# Enable MPU
CONFIG_ARM_MPU=y

# enable GPIO
CONFIG_GPIO=y

# 启用 Nordic nRFx GPIO 驱动
CONFIG_GPIO_NRFX=y

# Release P0.09 and P0.10 for GPIO use by disabling NFC
CONFIG_NFCT_PINS_AS_GPIOS=y

# Enable writing to flash
CONFIG_USE_DT_CODE_PARTITION=y
CONFIG_BUILD_OUTPUT_UF2=y
CONFIG_MPU_ALLOW_FLASH_WRITE=y
CONFIG_NVS=y
CONFIG_SETTINGS_NVS=y
CONFIG_FLASH=y
CONFIG_FLASH_PAGE_LAYOUT=y
CONFIG_FLASH_MAP=y

# Enable ZMK Studio by default
CONFIG_ZMK_STUDIO_LOCKING=n
```
